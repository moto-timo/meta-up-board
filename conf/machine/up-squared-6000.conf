## conf/machine/up-squared-6000.conf
```bitbake
#@TYPE: Machine
#@NAME: up-squared-6000

#@DESCRIPTION: Machine configuration for UP board systems

PREFERRED_PROVIDER_virtual/kernel ?= "linux-intel"
PREFERRED_VERSION_linux-intel ?= "6.1%"

# https://github.com/intel/linux-intel-lts/releases/tag/lts-v6.1.26-linux-230529T093135Z
KBRANCH = "6.1/linux"
LINUX_VERSION ?= "6.1.26"
SRCREV_machine ?= "58a6b58a4786fabf090a7ceb57ddd2b6f94c2282"
KMETA_BRANCH = "yocto-6.1"
SRCREV_meta ?= "6c9bc579ad765338fad63685f7d4dd5773fa2416"

require conf/machine/include/up-common.inc

# Include additional ACPI tables with the initrd
#EXTRA_IMAGEDEPENDS:append = " acpi-tables"
INITRD_LIVE:prepend = "${DEPLOY_DIR_IMAGE}/acpi-tables.cpio "

ACPI_TABLES ?= "upsquared-6000-spidev1.0.asl upsquared-6000-spidev1.1.asl"
```
